# ESP32-C6 register map
Vendor: ESPRESSIF SYSTEMS (SHANGHAI) CO., LTD.; Series: ESP32 C-Series; File version: 5
CPU: RV32IMAC r0p0, little endian, no MPU, no FPU, 4 interrupt priority bits
Address unit: 32 bits
Registers are 32-bit, read-write, reset 0x0 unless marked. A register's access mark holds for its fields unless they carry their own. Offsets are from the block's base; [hi:lo] are bit positions; {n}, {i} and the like mark numbered series.

## INTERRUPT_CORE0 — Interrupt Controller (Core 0)
Base 0x60010000
0x00 WIFI_MAC_INTR_MAP — register description
  [4:0] WIFI_MAC_INTR_MAP — Need add description
0x04 WIFI_MAC_NMI_MAP — register description
  [4:0] WIFI_MAC_NMI_MAP — Need add description
0x08 WIFI_PWR_INTR_MAP — register description
  [4:0] WIFI_PWR_INTR_MAP — Need add description
0x0C WIFI_BB_INTR_MAP — register description
  [4:0] WIFI_BB_INTR_MAP — Need add description
0x10 BT_MAC_INTR_MAP — register description
  [4:0] BT_MAC_INTR_MAP — Need add description
0x14 BT_BB_INTR_MAP — register description
  [4:0] BT_BB_INTR_MAP — Need add description
0x18 BT_BB_NMI_MAP — register description
  [4:0] BT_BB_NMI_MAP — Need add description
0x1C LP_TIMER_INTR_MAP — register description
  [4:0] LP_TIMER_INTR_MAP — Need add description
0x20 COEX_INTR_MAP — register description
  [4:0] COEX_INTR_MAP — Need add description
0x24 BLE_TIMER_INTR_MAP — register description
  [4:0] BLE_TIMER_INTR_MAP — Need add description
0x28 BLE_SEC_INTR_MAP — register description
  [4:0] BLE_SEC_INTR_MAP — Need add description
0x2C I2C_MST_INTR_MAP — register description
  [4:0] I2C_MST_INTR_MAP — Need add description
0x30 ZB_MAC_INTR_MAP — register description
  [4:0] ZB_MAC_INTR_MAP — Need add description
0x34 PMU_INTR_MAP — register description
  [4:0] PMU_INTR_MAP — Need add description
0x38 EFUSE_INTR_MAP — register description
  [4:0] EFUSE_INTR_MAP — Need add description
0x3C LP_RTC_TIMER_INTR_MAP — register description
  [4:0] LP_RTC_TIMER_INTR_MAP — Need add description
0x40 LP_UART_INTR_MAP — register description
  [4:0] LP_UART_INTR_MAP — Need add description
0x44 LP_I2C_INTR_MAP — register description
  [4:0] LP_I2C_INTR_MAP — Need add description
0x48 LP_WDT_INTR_MAP — register description
  [4:0] LP_WDT_INTR_MAP — Need add description
0x4C LP_PERI_TIMEOUT_INTR_MAP — register description
  [4:0] LP_PERI_TIMEOUT_INTR_MAP — Need add description
0x50 LP_APM_M0_INTR_MAP — register description
  [4:0] LP_APM_M0_INTR_MAP — Need add description
0x54 LP_APM_M1_INTR_MAP — register description
  [4:0] LP_APM_M1_INTR_MAP — Need add description
{0x58+4i} CPU_INTR_FROM_CPU_{i}_MAP (i=0..3) — register description
  [4:0] CPU_INTR_FROM_CPU_{i}_MAP — Need add description
0x68 ASSIST_DEBUG_INTR_MAP — register description
  [4:0] ASSIST_DEBUG_INTR_MAP — Need add description
0x6C TRACE_INTR_MAP — register description
  [4:0] TRACE_INTR_MAP — Need add description
0x70 CACHE_INTR_MAP — register description
  [4:0] CACHE_INTR_MAP — Need add description
0x74 CPU_PERI_TIMEOUT_INTR_MAP — register description
  [4:0] CPU_PERI_TIMEOUT_INTR_MAP — Need add description
0x78 GPIO_INTERRUPT_PRO_MAP — register description
  [4:0] GPIO_INTERRUPT_PRO_MAP — Need add description
0x7C GPIO_INTERRUPT_PRO_NMI_MAP — register description
  [4:0] GPIO_INTERRUPT_PRO_NMI_MAP — Need add description
0x80 PAU_INTR_MAP — register description
  [4:0] PAU_INTR_MAP — Need add description
0x84 HP_PERI_TIMEOUT_INTR_MAP — register description
  [4:0] HP_PERI_TIMEOUT_INTR_MAP — Need add description
0x88 MODEM_PERI_TIMEOUT_INTR_MAP — register description
  [4:0] MODEM_PERI_TIMEOUT_INTR_MAP — Need add description
{0x8C+4i} HP_APM_M{i}_INTR_MAP (i=0..3) — register description
  [4:0] HP_APM_M{i}_INTR_MAP — Need add description
0x9C LP_APM0_INTR_MAP — register description
  [4:0] LP_APM0_INTR_MAP — Need add description
0xA0 MSPI_INTR_MAP — register description
  [4:0] MSPI_INTR_MAP — Need add description
0xA4 I2S1_INTR_MAP — register description
  [4:0] I2S1_INTR_MAP — Need add description
0xA8 UHCI0_INTR_MAP — register description
  [4:0] UHCI0_INTR_MAP — Need add description
0xAC UART0_INTR_MAP — register description
  [4:0] UART0_INTR_MAP — Need add description
0xB0 UART1_INTR_MAP — register description
  [4:0] UART1_INTR_MAP — Need add description
0xB4 LEDC_INTR_MAP — register description
  [4:0] LEDC_INTR_MAP — Need add description
0xB8 CAN0_INTR_MAP — register description
  [4:0] CAN0_INTR_MAP — Need add description
0xBC CAN1_INTR_MAP — register description
  [4:0] CAN1_INTR_MAP — Need add description
0xC0 USB_INTR_MAP — register description
  [4:0] USB_INTR_MAP — Need add description
0xC4 RMT_INTR_MAP — register description
  [4:0] RMT_INTR_MAP — Need add description
0xC8 I2C_EXT0_INTR_MAP — register description
  [4:0] I2C_EXT0_INTR_MAP — Need add description
0xCC TG0_T0_INTR_MAP — register description
  [4:0] TG0_T0_INTR_MAP — Need add description
0xD0 TG0_T1_INTR_MAP — register description
  [4:0] TG0_T1_INTR_MAP — Need add description
0xD4 TG0_WDT_INTR_MAP — register description
  [4:0] TG0_WDT_INTR_MAP — Need add description
0xD8 TG1_T0_INTR_MAP — register description
  [4:0] TG1_T0_INTR_MAP — Need add description
0xDC TG1_T1_INTR_MAP — register description
  [4:0] TG1_T1_INTR_MAP — Need add description
0xE0 TG1_WDT_INTR_MAP — register description
  [4:0] TG1_WDT_INTR_MAP — Need add description
{0xE4+4i} SYSTIMER_TARGET{i}_INTR_MAP (i=0..2) — register description
  [4:0] SYSTIMER_TARGET{i}_INTR_MAP — Need add description
0xF0 APB_ADC_INTR_MAP — register description
  [4:0] APB_ADC_INTR_MAP — Need add description
0xF4 PWM_INTR_MAP — register description
  [4:0] PWM_INTR_MAP — Need add description
0xF8 PCNT_INTR_MAP — register description
  [4:0] PCNT_INTR_MAP — Need add description
0xFC PARL_IO_INTR_MAP — register description
  [4:0] PARL_IO_INTR_MAP — Need add description
0x100 SLC0_INTR_MAP — register description
  [4:0] SLC0_INTR_MAP — Need add description
0x104 SLC1_INTR_MAP — register description
  [4:0] SLC1_INTR_MAP — Need add description
{0x108+4i} DMA_IN_CH{i}_INTR_MAP (i=0..2) — register description
  [4:0] DMA_IN_CH{i}_INTR_MAP — Need add description
{0x114+4i} DMA_OUT_CH{i}_INTR_MAP (i=0..2) — register description
  [4:0] DMA_OUT_CH{i}_INTR_MAP — Need add description
0x120 GPSPI2_INTR_MAP — register description
  [4:0] GPSPI2_INTR_MAP — Need add description
0x124 AES_INTR_MAP — register description
  [4:0] AES_INTR_MAP — Need add description
0x128 SHA_INTR_MAP — register description
  [4:0] SHA_INTR_MAP — Need add description
0x12C RSA_INTR_MAP — register description
  [4:0] RSA_INTR_MAP — Need add description
0x130 ECC_INTR_MAP — register description
  [4:0] ECC_INTR_MAP — Need add description
0x134 INTR_STATUS_REG_0 ro — register description
  [31:0] INTR_STATUS_0 — Need add description
0x138 INTR_STATUS_REG_1 ro — register description
  [31:0] INTR_STATUS_1 — Need add description
0x13C INT_STATUS_REG_2 ro — register description
  [31:0] INT_STATUS_2 — Need add description
0x140 CLOCK_GATE reset 0x1 — register description
  [0] REG_CLK_EN — Need add description
0x7FC INTERRUPT_REG_DATE reset 0x2203110 — register description
  [27:0] INTERRUPT_REG_DATE — Need add description
